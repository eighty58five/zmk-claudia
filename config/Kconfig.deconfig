## config/Kconfig.deconfig
```kconfig
# Copyright (c) 2020 The ZMK Contributors
# SPDX-License-Identifier: MIT

if SHIELD_claudia

config ZMK_KEYBOARD_NAME
    default "claudia"

endif
```

## config/boards/shields/claudia/Kconfig.deconfig
```kconfig
# Copyright (c) 2020 The ZMK Contributors
# SPDX-License-Identifier: MIT

if SHIELD_CLAUDIA

config ZMK_KEYBOARD_NAME
    default "claudia"

endif
```

## config/boards/shields/claudia/Kconfig.shield
```kconfig
# Copyright (c) 2020 The ZMK Contributors
# SPDX-License-Identifier: MIT

config SHIELD_CLAUDIA
    def_bool $(shields_list_contains,claudia)
```
